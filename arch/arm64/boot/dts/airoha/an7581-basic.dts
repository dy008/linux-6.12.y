/dts-v1/;

#include <dt-bindings/interrupt-controller/irq.h>
#include <dt-bindings/interrupt-controller/arm-gic.h>
#include <dt-bindings/gpio/gpio.h>
#include <dt-bindings/leds/common.h>
#include <dt-bindings/input/input.h>

#include "an7581-base.dtsi"

/ {
	model = "Airoha EN7581 generic board";
	compatible = "airoha,en7581", "econet,en7581";

	config {
		bootdelay = <2>;
	};
};

&voip {
	slic-power-mode = "none";
};
